## conf/layer.conf
```bitbake
# We have a conf and classes directory, add to BBPATH
BBPATH .= ":${LAYERDIR}"

# We have recipes-* directories, add to BBFILES
BBFILES += "${LAYERDIR}/recipes-*/*/*.bb \
            ${LAYERDIR}/recipes-*/*/*.bbappend"

BBFILE_COLLECTIONS += "meta-custom-podman"
BBFILE_PATTERN_meta-custom-podman = "^${LAYERDIR}/"
BBFILE_PRIORITY_meta-custom-podman = "20"
LAYERVERSION_meta-custom-podman = "4"
LAYERDEPENDS_meta-custom-podman = "virtualization-layer"
LAYERSERIES_COMPAT_meta-custom-podman = "scarthgap"

DISTRO_FEATURES_VIRTUALIZATION = " virtualization"
DISTRO_FEATURES_PODMAN = "seccomp kvm aufs sysvinit"

DISTRO_FEATURES:append = "${DISTRO_FEATURES_VIRTUALIZATION} \
                          ${DISTRO_FEATURES_PODMAN} \
                        "
                        
```
